CM_ "AUTOGENERATED FILE, DO NOT EDIT";

CM_ "hyundai_canfd_corner_radar_430.dbc starts here";
VERSION ""

NS_ :

BS_:

BU_: XXX RADAR

BA_DEF_ BO_  "GenMsgCycleTime" INT 0 100000;
BA_DEF_DEF_  "GenMsgCycleTime" 0;

BO_ 1072 CORNER_RADAR_430_OBJECTS_430: 32 RADAR
 SG_ HEADER_BYTE_0 : 0|8@1+ (1,0) [0|255] "" XXX
 SG_ HEADER_BYTE_1 : 8|8@1+ (1,0) [0|255] "" XXX
 SG_ HEADER_BYTE_2 : 16|8@1+ (1,0) [0|255] "" XXX
 SG_ HEADER_BYTE_3 : 24|8@1+ (1,0) [0|255] "" XXX
 SG_ SLOT1_DISTANCE_RAW : 32|13@1+ (1,0) [0|8191] "" XXX
 SG_ SLOT1_META_13_15 : 45|3@1+ (1,0) [0|7] "" XXX
 SG_ SLOT1_META_BYTE_2 : 48|8@1+ (1,0) [0|255] "" XXX
 SG_ SLOT1_META_BYTE_3 : 56|8@1+ (1,0) [0|255] "" XXX
 SG_ SLOT2_DISTANCE_RAW : 64|13@1+ (1,0) [0|8191] "" XXX
 SG_ SLOT2_META_13_15 : 77|3@1+ (1,0) [0|7] "" XXX
 SG_ SLOT2_META_BYTE_2 : 80|8@1+ (1,0) [0|255] "" XXX
 SG_ SLOT2_META_BYTE_3 : 88|8@1+ (1,0) [0|255] "" XXX
 SG_ SLOT3_DISTANCE_RAW : 96|13@1+ (1,0) [0|8191] "" XXX
 SG_ SLOT3_META_13_15 : 109|3@1+ (1,0) [0|7] "" XXX
 SG_ SLOT3_META_BYTE_2 : 112|8@1+ (1,0) [0|255] "" XXX
 SG_ SLOT3_META_BYTE_3 : 120|8@1+ (1,0) [0|255] "" XXX
 SG_ SLOT4_DISTANCE_RAW : 128|13@1+ (1,0) [0|8191] "" XXX
 SG_ SLOT4_META_13_15 : 141|3@1+ (1,0) [0|7] "" XXX
 SG_ SLOT4_META_BYTE_2 : 144|8@1+ (1,0) [0|255] "" XXX
 SG_ SLOT4_META_BYTE_3 : 152|8@1+ (1,0) [0|255] "" XXX
 SG_ SLOT5_DISTANCE_RAW : 160|13@1+ (1,0) [0|8191] "" XXX
 SG_ SLOT5_META_13_15 : 173|3@1+ (1,0) [0|7] "" XXX
 SG_ SLOT5_META_BYTE_2 : 176|8@1+ (1,0) [0|255] "" XXX
 SG_ SLOT5_META_BYTE_3 : 184|8@1+ (1,0) [0|255] "" XXX
 SG_ SLOT6_DISTANCE_RAW : 192|13@1+ (1,0) [0|8191] "" XXX
 SG_ SLOT6_META_13_15 : 205|3@1+ (1,0) [0|7] "" XXX
 SG_ SLOT6_META_BYTE_2 : 208|8@1+ (1,0) [0|255] "" XXX
 SG_ SLOT6_META_BYTE_3 : 216|8@1+ (1,0) [0|255] "" XXX
 SG_ SLOT7_DISTANCE_RAW : 224|13@1+ (1,0) [0|8191] "" XXX
 SG_ SLOT7_META_13_15 : 237|3@1+ (1,0) [0|7] "" XXX
 SG_ SLOT7_META_BYTE_2 : 240|8@1+ (1,0) [0|255] "" XXX
 SG_ SLOT7_META_BYTE_3 : 248|8@1+ (1,0) [0|255] "" XXX
CM_ BO_ 1072 "IONIQ 9 candidate corner radar bin container. 0x430-0x437 correlate with left side and 0x440-0x447 with right side. Bytes 4-31 appear as seven 4-byte slots; lower 13 bits are a distance candidate at 0.05 m scale. This DBC intentionally exposes only raw candidate fields until lateral and velocity fields are validated.";
BA_ "GenMsgCycleTime" BO_ 1072 30;

BO_ 1073 CORNER_RADAR_430_OBJECTS_431: 32 RADAR
 SG_ HEADER_BYTE_0 : 0|8@1+ (1,0) [0|255] "" XXX
 SG_ HEADER_BYTE_1 : 8|8@1+ (1,0) [0|255] "" XXX
 SG_ HEADER_BYTE_2 : 16|8@1+ (1,0) [0|255] "" XXX
 SG_ HEADER_BYTE_3 : 24|8@1+ (1,0) [0|255] "" XXX
 SG_ SLOT1_DISTANCE_RAW : 32|13@1+ (1,0) [0|8191] "" XXX
 SG_ SLOT1_META_13_15 : 45|3@1+ (1,0) [0|7] "" XXX
 SG_ SLOT1_META_BYTE_2 : 48|8@1+ (1,0) [0|255] "" XXX
 SG_ SLOT1_META_BYTE_3 : 56|8@1+ (1,0) [0|255] "" XXX
 SG_ SLOT2_DISTANCE_RAW : 64|13@1+ (1,0) [0|8191] "" XXX
 SG_ SLOT2_META_13_15 : 77|3@1+ (1,0) [0|7] "" XXX
 SG_ SLOT2_META_BYTE_2 : 80|8@1+ (1,0) [0|255] "" XXX
 SG_ SLOT2_META_BYTE_3 : 88|8@1+ (1,0) [0|255] "" XXX
 SG_ SLOT3_DISTANCE_RAW : 96|13@1+ (1,0) [0|8191] "" XXX
 SG_ SLOT3_META_13_15 : 109|3@1+ (1,0) [0|7] "" XXX
 SG_ SLOT3_META_BYTE_2 : 112|8@1+ (1,0) [0|255] "" XXX
 SG_ SLOT3_META_BYTE_3 : 120|8@1+ (1,0) [0|255] "" XXX
 SG_ SLOT4_DISTANCE_RAW : 128|13@1+ (1,0) [0|8191] "" XXX
 SG_ SLOT4_META_13_15 : 141|3@1+ (1,0) [0|7] "" XXX
 SG_ SLOT4_META_BYTE_2 : 144|8@1+ (1,0) [0|255] "" XXX
 SG_ SLOT4_META_BYTE_3 : 152|8@1+ (1,0) [0|255] "" XXX
 SG_ SLOT5_DISTANCE_RAW : 160|13@1+ (1,0) [0|8191] "" XXX
 SG_ SLOT5_META_13_15 : 173|3@1+ (1,0) [0|7] "" XXX
 SG_ SLOT5_META_BYTE_2 : 176|8@1+ (1,0) [0|255] "" XXX
 SG_ SLOT5_META_BYTE_3 : 184|8@1+ (1,0) [0|255] "" XXX
 SG_ SLOT6_DISTANCE_RAW : 192|13@1+ (1,0) [0|8191] "" XXX
 SG_ SLOT6_META_13_15 : 205|3@1+ (1,0) [0|7] "" XXX
 SG_ SLOT6_META_BYTE_2 : 208|8@1+ (1,0) [0|255] "" XXX
 SG_ SLOT6_META_BYTE_3 : 216|8@1+ (1,0) [0|255] "" XXX
 SG_ SLOT7_DISTANCE_RAW : 224|13@1+ (1,0) [0|8191] "" XXX
 SG_ SLOT7_META_13_15 : 237|3@1+ (1,0) [0|7] "" XXX
 SG_ SLOT7_META_BYTE_2 : 240|8@1+ (1,0) [0|255] "" XXX
 SG_ SLOT7_META_BYTE_3 : 248|8@1+ (1,0) [0|255] "" XXX
CM_ BO_ 1073 "IONIQ 9 candidate corner radar bin container. 0x430-0x437 correlate with left side and 0x440-0x447 with right side. Bytes 4-31 appear as seven 4-byte slots; lower 13 bits are a distance candidate at 0.05 m scale. This DBC intentionally exposes only raw candidate fields until lateral and velocity fields are validated.";
BA_ "GenMsgCycleTime" BO_ 1073 30;

BO_ 1074 CORNER_RADAR_430_OBJECTS_432: 32 RADAR
 SG_ HEADER_BYTE_0 : 0|8@1+ (1,0) [0|255] "" XXX
 SG_ HEADER_BYTE_1 : 8|8@1+ (1,0) [0|255] "" XXX
 SG_ HEADER_BYTE_2 : 16|8@1+ (1,0) [0|255] "" XXX
 SG_ HEADER_BYTE_3 : 24|8@1+ (1,0) [0|255] "" XXX
 SG_ SLOT1_DISTANCE_RAW : 32|13@1+ (1,0) [0|8191] "" XXX
 SG_ SLOT1_META_13_15 : 45|3@1+ (1,0) [0|7] "" XXX
 SG_ SLOT1_META_BYTE_2 : 48|8@1+ (1,0) [0|255] "" XXX
 SG_ SLOT1_META_BYTE_3 : 56|8@1+ (1,0) [0|255] "" XXX
 SG_ SLOT2_DISTANCE_RAW : 64|13@1+ (1,0) [0|8191] "" XXX
 SG_ SLOT2_META_13_15 : 77|3@1+ (1,0) [0|7] "" XXX
 SG_ SLOT2_META_BYTE_2 : 80|8@1+ (1,0) [0|255] "" XXX
 SG_ SLOT2_META_BYTE_3 : 88|8@1+ (1,0) [0|255] "" XXX
 SG_ SLOT3_DISTANCE_RAW : 96|13@1+ (1,0) [0|8191] "" XXX
 SG_ SLOT3_META_13_15 : 109|3@1+ (1,0) [0|7] "" XXX
 SG_ SLOT3_META_BYTE_2 : 112|8@1+ (1,0) [0|255] "" XXX
 SG_ SLOT3_META_BYTE_3 : 120|8@1+ (1,0) [0|255] "" XXX
 SG_ SLOT4_DISTANCE_RAW : 128|13@1+ (1,0) [0|8191] "" XXX
 SG_ SLOT4_META_13_15 : 141|3@1+ (1,0) [0|7] "" XXX
 SG_ SLOT4_META_BYTE_2 : 144|8@1+ (1,0) [0|255] "" XXX
 SG_ SLOT4_META_BYTE_3 : 152|8@1+ (1,0) [0|255] "" XXX
 SG_ SLOT5_DISTANCE_RAW : 160|13@1+ (1,0) [0|8191] "" XXX
 SG_ SLOT5_META_13_15 : 173|3@1+ (1,0) [0|7] "" XXX
 SG_ SLOT5_META_BYTE_2 : 176|8@1+ (1,0) [0|255] "" XXX
 SG_ SLOT5_META_BYTE_3 : 184|8@1+ (1,0) [0|255] "" XXX
 SG_ SLOT6_DISTANCE_RAW : 192|13@1+ (1,0) [0|8191] "" XXX
 SG_ SLOT6_META_13_15 : 205|3@1+ (1,0) [0|7] "" XXX
 SG_ SLOT6_META_BYTE_2 : 208|8@1+ (1,0) [0|255] "" XXX
 SG_ SLOT6_META_BYTE_3 : 216|8@1+ (1,0) [0|255] "" XXX
 SG_ SLOT7_DISTANCE_RAW : 224|13@1+ (1,0) [0|8191] "" XXX
 SG_ SLOT7_META_13_15 : 237|3@1+ (1,0) [0|7] "" XXX
 SG_ SLOT7_META_BYTE_2 : 240|8@1+ (1,0) [0|255] "" XXX
 SG_ SLOT7_META_BYTE_3 : 248|8@1+ (1,0) [0|255] "" XXX
CM_ BO_ 1074 "IONIQ 9 candidate corner radar bin container. 0x430-0x437 correlate with left side and 0x440-0x447 with right side. Bytes 4-31 appear as seven 4-byte slots; lower 13 bits are a distance candidate at 0.05 m scale. This DBC intentionally exposes only raw candidate fields until lateral and velocity fields are validated.";
BA_ "GenMsgCycleTime" BO_ 1074 30;

BO_ 1075 CORNER_RADAR_430_OBJECTS_433: 32 RADAR
 SG_ HEADER_BYTE_0 : 0|8@1+ (1,0) [0|255] "" XXX
 SG_ HEADER_BYTE_1 : 8|8@1+ (1,0) [0|255] "" XXX
 SG_ HEADER_BYTE_2 : 16|8@1+ (1,0) [0|255] "" XXX
 SG_ HEADER_BYTE_3 : 24|8@1+ (1,0) [0|255] "" XXX
 SG_ SLOT1_DISTANCE_RAW : 32|13@1+ (1,0) [0|8191] "" XXX
 SG_ SLOT1_META_13_15 : 45|3@1+ (1,0) [0|7] "" XXX
 SG_ SLOT1_META_BYTE_2 : 48|8@1+ (1,0) [0|255] "" XXX
 SG_ SLOT1_META_BYTE_3 : 56|8@1+ (1,0) [0|255] "" XXX
 SG_ SLOT2_DISTANCE_RAW : 64|13@1+ (1,0) [0|8191] "" XXX
 SG_ SLOT2_META_13_15 : 77|3@1+ (1,0) [0|7] "" XXX
 SG_ SLOT2_META_BYTE_2 : 80|8@1+ (1,0) [0|255] "" XXX
 SG_ SLOT2_META_BYTE_3 : 88|8@1+ (1,0) [0|255] "" XXX
 SG_ SLOT3_DISTANCE_RAW : 96|13@1+ (1,0) [0|8191] "" XXX
 SG_ SLOT3_META_13_15 : 109|3@1+ (1,0) [0|7] "" XXX
 SG_ SLOT3_META_BYTE_2 : 112|8@1+ (1,0) [0|255] "" XXX
 SG_ SLOT3_META_BYTE_3 : 120|8@1+ (1,0) [0|255] "" XXX
 SG_ SLOT4_DISTANCE_RAW : 128|13@1+ (1,0) [0|8191] "" XXX
 SG_ SLOT4_META_13_15 : 141|3@1+ (1,0) [0|7] "" XXX
 SG_ SLOT4_META_BYTE_2 : 144|8@1+ (1,0) [0|255] "" XXX
 SG_ SLOT4_META_BYTE_3 : 152|8@1+ (1,0) [0|255] "" XXX
 SG_ SLOT5_DISTANCE_RAW : 160|13@1+ (1,0) [0|8191] "" XXX
 SG_ SLOT5_META_13_15 : 173|3@1+ (1,0) [0|7] "" XXX
 SG_ SLOT5_META_BYTE_2 : 176|8@1+ (1,0) [0|255] "" XXX
 SG_ SLOT5_META_BYTE_3 : 184|8@1+ (1,0) [0|255] "" XXX
 SG_ SLOT6_DISTANCE_RAW : 192|13@1+ (1,0) [0|8191] "" XXX
 SG_ SLOT6_META_13_15 : 205|3@1+ (1,0) [0|7] "" XXX
 SG_ SLOT6_META_BYTE_2 : 208|8@1+ (1,0) [0|255] "" XXX
 SG_ SLOT6_META_BYTE_3 : 216|8@1+ (1,0) [0|255] "" XXX
 SG_ SLOT7_DISTANCE_RAW : 224|13@1+ (1,0) [0|8191] "" XXX
 SG_ SLOT7_META_13_15 : 237|3@1+ (1,0) [0|7] "" XXX
 SG_ SLOT7_META_BYTE_2 : 240|8@1+ (1,0) [0|255] "" XXX
 SG_ SLOT7_META_BYTE_3 : 248|8@1+ (1,0) [0|255] "" XXX
CM_ BO_ 1075 "IONIQ 9 candidate corner radar bin container. 0x430-0x437 correlate with left side and 0x440-0x447 with right side. Bytes 4-31 appear as seven 4-byte slots; lower 13 bits are a distance candidate at 0.05 m scale. This DBC intentionally exposes only raw candidate fields until lateral and velocity fields are validated.";
BA_ "GenMsgCycleTime" BO_ 1075 30;

BO_ 1076 CORNER_RADAR_430_OBJECTS_434: 32 RADAR
 SG_ HEADER_BYTE_0 : 0|8@1+ (1,0) [0|255] "" XXX
 SG_ HEADER_BYTE_1 : 8|8@1+ (1,0) [0|255] "" XXX
 SG_ HEADER_BYTE_2 : 16|8@1+ (1,0) [0|255] "" XXX
 SG_ HEADER_BYTE_3 : 24|8@1+ (1,0) [0|255] "" XXX
 SG_ SLOT1_DISTANCE_RAW : 32|13@1+ (1,0) [0|8191] "" XXX
 SG_ SLOT1_META_13_15 : 45|3@1+ (1,0) [0|7] "" XXX
 SG_ SLOT1_META_BYTE_2 : 48|8@1+ (1,0) [0|255] "" XXX
 SG_ SLOT1_META_BYTE_3 : 56|8@1+ (1,0) [0|255] "" XXX
 SG_ SLOT2_DISTANCE_RAW : 64|13@1+ (1,0) [0|8191] "" XXX
 SG_ SLOT2_META_13_15 : 77|3@1+ (1,0) [0|7] "" XXX
 SG_ SLOT2_META_BYTE_2 : 80|8@1+ (1,0) [0|255] "" XXX
 SG_ SLOT2_META_BYTE_3 : 88|8@1+ (1,0) [0|255] "" XXX
 SG_ SLOT3_DISTANCE_RAW : 96|13@1+ (1,0) [0|8191] "" XXX
 SG_ SLOT3_META_13_15 : 109|3@1+ (1,0) [0|7] "" XXX
 SG_ SLOT3_META_BYTE_2 : 112|8@1+ (1,0) [0|255] "" XXX
 SG_ SLOT3_META_BYTE_3 : 120|8@1+ (1,0) [0|255] "" XXX
 SG_ SLOT4_DISTANCE_RAW : 128|13@1+ (1,0) [0|8191] "" XXX
 SG_ SLOT4_META_13_15 : 141|3@1+ (1,0) [0|7] "" XXX
 SG_ SLOT4_META_BYTE_2 : 144|8@1+ (1,0) [0|255] "" XXX
 SG_ SLOT4_META_BYTE_3 : 152|8@1+ (1,0) [0|255] "" XXX
 SG_ SLOT5_DISTANCE_RAW : 160|13@1+ (1,0) [0|8191] "" XXX
 SG_ SLOT5_META_13_15 : 173|3@1+ (1,0) [0|7] "" XXX
 SG_ SLOT5_META_BYTE_2 : 176|8@1+ (1,0) [0|255] "" XXX
 SG_ SLOT5_META_BYTE_3 : 184|8@1+ (1,0) [0|255] "" XXX
 SG_ SLOT6_DISTANCE_RAW : 192|13@1+ (1,0) [0|8191] "" XXX
 SG_ SLOT6_META_13_15 : 205|3@1+ (1,0) [0|7] "" XXX
 SG_ SLOT6_META_BYTE_2 : 208|8@1+ (1,0) [0|255] "" XXX
 SG_ SLOT6_META_BYTE_3 : 216|8@1+ (1,0) [0|255] "" XXX
 SG_ SLOT7_DISTANCE_RAW : 224|13@1+ (1,0) [0|8191] "" XXX
 SG_ SLOT7_META_13_15 : 237|3@1+ (1,0) [0|7] "" XXX
 SG_ SLOT7_META_BYTE_2 : 240|8@1+ (1,0) [0|255] "" XXX
 SG_ SLOT7_META_BYTE_3 : 248|8@1+ (1,0) [0|255] "" XXX
CM_ BO_ 1076 "IONIQ 9 candidate corner radar bin container. 0x430-0x437 correlate with left side and 0x440-0x447 with right side. Bytes 4-31 appear as seven 4-byte slots; lower 13 bits are a distance candidate at 0.05 m scale. This DBC intentionally exposes only raw candidate fields until lateral and velocity fields are validated.";
BA_ "GenMsgCycleTime" BO_ 1076 30;

BO_ 1077 CORNER_RADAR_430_OBJECTS_435: 32 RADAR
 SG_ HEADER_BYTE_0 : 0|8@1+ (1,0) [0|255] "" XXX
 SG_ HEADER_BYTE_1 : 8|8@1+ (1,0) [0|255] "" XXX
 SG_ HEADER_BYTE_2 : 16|8@1+ (1,0) [0|255] "" XXX
 SG_ HEADER_BYTE_3 : 24|8@1+ (1,0) [0|255] "" XXX
 SG_ SLOT1_DISTANCE_RAW : 32|13@1+ (1,0) [0|8191] "" XXX
 SG_ SLOT1_META_13_15 : 45|3@1+ (1,0) [0|7] "" XXX
 SG_ SLOT1_META_BYTE_2 : 48|8@1+ (1,0) [0|255] "" XXX
 SG_ SLOT1_META_BYTE_3 : 56|8@1+ (1,0) [0|255] "" XXX
 SG_ SLOT2_DISTANCE_RAW : 64|13@1+ (1,0) [0|8191] "" XXX
 SG_ SLOT2_META_13_15 : 77|3@1+ (1,0) [0|7] "" XXX
 SG_ SLOT2_META_BYTE_2 : 80|8@1+ (1,0) [0|255] "" XXX
 SG_ SLOT2_META_BYTE_3 : 88|8@1+ (1,0) [0|255] "" XXX
 SG_ SLOT3_DISTANCE_RAW : 96|13@1+ (1,0) [0|8191] "" XXX
 SG_ SLOT3_META_13_15 : 109|3@1+ (1,0) [0|7] "" XXX
 SG_ SLOT3_META_BYTE_2 : 112|8@1+ (1,0) [0|255] "" XXX
 SG_ SLOT3_META_BYTE_3 : 120|8@1+ (1,0) [0|255] "" XXX
 SG_ SLOT4_DISTANCE_RAW : 128|13@1+ (1,0) [0|8191] "" XXX
 SG_ SLOT4_META_13_15 : 141|3@1+ (1,0) [0|7] "" XXX
 SG_ SLOT4_META_BYTE_2 : 144|8@1+ (1,0) [0|255] "" XXX
 SG_ SLOT4_META_BYTE_3 : 152|8@1+ (1,0) [0|255] "" XXX
 SG_ SLOT5_DISTANCE_RAW : 160|13@1+ (1,0) [0|8191] "" XXX
 SG_ SLOT5_META_13_15 : 173|3@1+ (1,0) [0|7] "" XXX
 SG_ SLOT5_META_BYTE_2 : 176|8@1+ (1,0) [0|255] "" XXX
 SG_ SLOT5_META_BYTE_3 : 184|8@1+ (1,0) [0|255] "" XXX
 SG_ SLOT6_DISTANCE_RAW : 192|13@1+ (1,0) [0|8191] "" XXX
 SG_ SLOT6_META_13_15 : 205|3@1+ (1,0) [0|7] "" XXX
 SG_ SLOT6_META_BYTE_2 : 208|8@1+ (1,0) [0|255] "" XXX
 SG_ SLOT6_META_BYTE_3 : 216|8@1+ (1,0) [0|255] "" XXX
 SG_ SLOT7_DISTANCE_RAW : 224|13@1+ (1,0) [0|8191] "" XXX
 SG_ SLOT7_META_13_15 : 237|3@1+ (1,0) [0|7] "" XXX
 SG_ SLOT7_META_BYTE_2 : 240|8@1+ (1,0) [0|255] "" XXX
 SG_ SLOT7_META_BYTE_3 : 248|8@1+ (1,0) [0|255] "" XXX
CM_ BO_ 1077 "IONIQ 9 candidate corner radar bin container. 0x430-0x437 correlate with left side and 0x440-0x447 with right side. Bytes 4-31 appear as seven 4-byte slots; lower 13 bits are a distance candidate at 0.05 m scale. This DBC intentionally exposes only raw candidate fields until lateral and velocity fields are validated.";
BA_ "GenMsgCycleTime" BO_ 1077 30;

BO_ 1078 CORNER_RADAR_430_OBJECTS_436: 32 RADAR
 SG_ HEADER_BYTE_0 : 0|8@1+ (1,0) [0|255] "" XXX
 SG_ HEADER_BYTE_1 : 8|8@1+ (1,0) [0|255] "" XXX
 SG_ HEADER_BYTE_2 : 16|8@1+ (1,0) [0|255] "" XXX
 SG_ HEADER_BYTE_3 : 24|8@1+ (1,0) [0|255] "" XXX
 SG_ SLOT1_DISTANCE_RAW : 32|13@1+ (1,0) [0|8191] "" XXX
 SG_ SLOT1_META_13_15 : 45|3@1+ (1,0) [0|7] "" XXX
 SG_ SLOT1_META_BYTE_2 : 48|8@1+ (1,0) [0|255] "" XXX
 SG_ SLOT1_META_BYTE_3 : 56|8@1+ (1,0) [0|255] "" XXX
 SG_ SLOT2_DISTANCE_RAW : 64|13@1+ (1,0) [0|8191] "" XXX
 SG_ SLOT2_META_13_15 : 77|3@1+ (1,0) [0|7] "" XXX
 SG_ SLOT2_META_BYTE_2 : 80|8@1+ (1,0) [0|255] "" XXX
 SG_ SLOT2_META_BYTE_3 : 88|8@1+ (1,0) [0|255] "" XXX
 SG_ SLOT3_DISTANCE_RAW : 96|13@1+ (1,0) [0|8191] "" XXX
 SG_ SLOT3_META_13_15 : 109|3@1+ (1,0) [0|7] "" XXX
 SG_ SLOT3_META_BYTE_2 : 112|8@1+ (1,0) [0|255] "" XXX
 SG_ SLOT3_META_BYTE_3 : 120|8@1+ (1,0) [0|255] "" XXX
 SG_ SLOT4_DISTANCE_RAW : 128|13@1+ (1,0) [0|8191] "" XXX
 SG_ SLOT4_META_13_15 : 141|3@1+ (1,0) [0|7] "" XXX
 SG_ SLOT4_META_BYTE_2 : 144|8@1+ (1,0) [0|255] "" XXX
 SG_ SLOT4_META_BYTE_3 : 152|8@1+ (1,0) [0|255] "" XXX
 SG_ SLOT5_DISTANCE_RAW : 160|13@1+ (1,0) [0|8191] "" XXX
 SG_ SLOT5_META_13_15 : 173|3@1+ (1,0) [0|7] "" XXX
 SG_ SLOT5_META_BYTE_2 : 176|8@1+ (1,0) [0|255] "" XXX
 SG_ SLOT5_META_BYTE_3 : 184|8@1+ (1,0) [0|255] "" XXX
 SG_ SLOT6_DISTANCE_RAW : 192|13@1+ (1,0) [0|8191] "" XXX
 SG_ SLOT6_META_13_15 : 205|3@1+ (1,0) [0|7] "" XXX
 SG_ SLOT6_META_BYTE_2 : 208|8@1+ (1,0) [0|255] "" XXX
 SG_ SLOT6_META_BYTE_3 : 216|8@1+ (1,0) [0|255] "" XXX
 SG_ SLOT7_DISTANCE_RAW : 224|13@1+ (1,0) [0|8191] "" XXX
 SG_ SLOT7_META_13_15 : 237|3@1+ (1,0) [0|7] "" XXX
 SG_ SLOT7_META_BYTE_2 : 240|8@1+ (1,0) [0|255] "" XXX
 SG_ SLOT7_META_BYTE_3 : 248|8@1+ (1,0) [0|255] "" XXX
CM_ BO_ 1078 "IONIQ 9 candidate corner radar bin container. 0x430-0x437 correlate with left side and 0x440-0x447 with right side. Bytes 4-31 appear as seven 4-byte slots; lower 13 bits are a distance candidate at 0.05 m scale. This DBC intentionally exposes only raw candidate fields until lateral and velocity fields are validated.";
BA_ "GenMsgCycleTime" BO_ 1078 30;

BO_ 1079 CORNER_RADAR_430_OBJECTS_437: 32 RADAR
 SG_ HEADER_BYTE_0 : 0|8@1+ (1,0) [0|255] "" XXX
 SG_ HEADER_BYTE_1 : 8|8@1+ (1,0) [0|255] "" XXX
 SG_ HEADER_BYTE_2 : 16|8@1+ (1,0) [0|255] "" XXX
 SG_ HEADER_BYTE_3 : 24|8@1+ (1,0) [0|255] "" XXX
 SG_ SLOT1_DISTANCE_RAW : 32|13@1+ (1,0) [0|8191] "" XXX
 SG_ SLOT1_META_13_15 : 45|3@1+ (1,0) [0|7] "" XXX
 SG_ SLOT1_META_BYTE_2 : 48|8@1+ (1,0) [0|255] "" XXX
 SG_ SLOT1_META_BYTE_3 : 56|8@1+ (1,0) [0|255] "" XXX
 SG_ SLOT2_DISTANCE_RAW : 64|13@1+ (1,0) [0|8191] "" XXX
 SG_ SLOT2_META_13_15 : 77|3@1+ (1,0) [0|7] "" XXX
 SG_ SLOT2_META_BYTE_2 : 80|8@1+ (1,0) [0|255] "" XXX
 SG_ SLOT2_META_BYTE_3 : 88|8@1+ (1,0) [0|255] "" XXX
 SG_ SLOT3_DISTANCE_RAW : 96|13@1+ (1,0) [0|8191] "" XXX
 SG_ SLOT3_META_13_15 : 109|3@1+ (1,0) [0|7] "" XXX
 SG_ SLOT3_META_BYTE_2 : 112|8@1+ (1,0) [0|255] "" XXX
 SG_ SLOT3_META_BYTE_3 : 120|8@1+ (1,0) [0|255] "" XXX
 SG_ SLOT4_DISTANCE_RAW : 128|13@1+ (1,0) [0|8191] "" XXX
 SG_ SLOT4_META_13_15 : 141|3@1+ (1,0) [0|7] "" XXX
 SG_ SLOT4_META_BYTE_2 : 144|8@1+ (1,0) [0|255] "" XXX
 SG_ SLOT4_META_BYTE_3 : 152|8@1+ (1,0) [0|255] "" XXX
 SG_ SLOT5_DISTANCE_RAW : 160|13@1+ (1,0) [0|8191] "" XXX
 SG_ SLOT5_META_13_15 : 173|3@1+ (1,0) [0|7] "" XXX
 SG_ SLOT5_META_BYTE_2 : 176|8@1+ (1,0) [0|255] "" XXX
 SG_ SLOT5_META_BYTE_3 : 184|8@1+ (1,0) [0|255] "" XXX
 SG_ SLOT6_DISTANCE_RAW : 192|13@1+ (1,0) [0|8191] "" XXX
 SG_ SLOT6_META_13_15 : 205|3@1+ (1,0) [0|7] "" XXX
 SG_ SLOT6_META_BYTE_2 : 208|8@1+ (1,0) [0|255] "" XXX
 SG_ SLOT6_META_BYTE_3 : 216|8@1+ (1,0) [0|255] "" XXX
 SG_ SLOT7_DISTANCE_RAW : 224|13@1+ (1,0) [0|8191] "" XXX
 SG_ SLOT7_META_13_15 : 237|3@1+ (1,0) [0|7] "" XXX
 SG_ SLOT7_META_BYTE_2 : 240|8@1+ (1,0) [0|255] "" XXX
 SG_ SLOT7_META_BYTE_3 : 248|8@1+ (1,0) [0|255] "" XXX
CM_ BO_ 1079 "IONIQ 9 candidate corner radar bin container. 0x430-0x437 correlate with left side and 0x440-0x447 with right side. Bytes 4-31 appear as seven 4-byte slots; lower 13 bits are a distance candidate at 0.05 m scale. This DBC intentionally exposes only raw candidate fields until lateral and velocity fields are validated.";
BA_ "GenMsgCycleTime" BO_ 1079 30;

BO_ 1088 CORNER_RADAR_430_OBJECTS_440: 32 RADAR
 SG_ HEADER_BYTE_0 : 0|8@1+ (1,0) [0|255] "" XXX
 SG_ HEADER_BYTE_1 : 8|8@1+ (1,0) [0|255] "" XXX
 SG_ HEADER_BYTE_2 : 16|8@1+ (1,0) [0|255] "" XXX
 SG_ HEADER_BYTE_3 : 24|8@1+ (1,0) [0|255] "" XXX
 SG_ SLOT1_DISTANCE_RAW : 32|13@1+ (1,0) [0|8191] "" XXX
 SG_ SLOT1_META_13_15 : 45|3@1+ (1,0) [0|7] "" XXX
 SG_ SLOT1_META_BYTE_2 : 48|8@1+ (1,0) [0|255] "" XXX
 SG_ SLOT1_META_BYTE_3 : 56|8@1+ (1,0) [0|255] "" XXX
 SG_ SLOT2_DISTANCE_RAW : 64|13@1+ (1,0) [0|8191] "" XXX
 SG_ SLOT2_META_13_15 : 77|3@1+ (1,0) [0|7] "" XXX
 SG_ SLOT2_META_BYTE_2 : 80|8@1+ (1,0) [0|255] "" XXX
 SG_ SLOT2_META_BYTE_3 : 88|8@1+ (1,0) [0|255] "" XXX
 SG_ SLOT3_DISTANCE_RAW : 96|13@1+ (1,0) [0|8191] "" XXX
 SG_ SLOT3_META_13_15 : 109|3@1+ (1,0) [0|7] "" XXX
 SG_ SLOT3_META_BYTE_2 : 112|8@1+ (1,0) [0|255] "" XXX
 SG_ SLOT3_META_BYTE_3 : 120|8@1+ (1,0) [0|255] "" XXX
 SG_ SLOT4_DISTANCE_RAW : 128|13@1+ (1,0) [0|8191] "" XXX
 SG_ SLOT4_META_13_15 : 141|3@1+ (1,0) [0|7] "" XXX
 SG_ SLOT4_META_BYTE_2 : 144|8@1+ (1,0) [0|255] "" XXX
 SG_ SLOT4_META_BYTE_3 : 152|8@1+ (1,0) [0|255] "" XXX
 SG_ SLOT5_DISTANCE_RAW : 160|13@1+ (1,0) [0|8191] "" XXX
 SG_ SLOT5_META_13_15 : 173|3@1+ (1,0) [0|7] "" XXX
 SG_ SLOT5_META_BYTE_2 : 176|8@1+ (1,0) [0|255] "" XXX
 SG_ SLOT5_META_BYTE_3 : 184|8@1+ (1,0) [0|255] "" XXX
 SG_ SLOT6_DISTANCE_RAW : 192|13@1+ (1,0) [0|8191] "" XXX
 SG_ SLOT6_META_13_15 : 205|3@1+ (1,0) [0|7] "" XXX
 SG_ SLOT6_META_BYTE_2 : 208|8@1+ (1,0) [0|255] "" XXX
 SG_ SLOT6_META_BYTE_3 : 216|8@1+ (1,0) [0|255] "" XXX
 SG_ SLOT7_DISTANCE_RAW : 224|13@1+ (1,0) [0|8191] "" XXX
 SG_ SLOT7_META_13_15 : 237|3@1+ (1,0) [0|7] "" XXX
 SG_ SLOT7_META_BYTE_2 : 240|8@1+ (1,0) [0|255] "" XXX
 SG_ SLOT7_META_BYTE_3 : 248|8@1+ (1,0) [0|255] "" XXX
CM_ BO_ 1088 "IONIQ 9 candidate corner radar bin container. 0x430-0x437 correlate with left side and 0x440-0x447 with right side. Bytes 4-31 appear as seven 4-byte slots; lower 13 bits are a distance candidate at 0.05 m scale. This DBC intentionally exposes only raw candidate fields until lateral and velocity fields are validated.";
BA_ "GenMsgCycleTime" BO_ 1088 30;

BO_ 1089 CORNER_RADAR_430_OBJECTS_441: 32 RADAR
 SG_ HEADER_BYTE_0 : 0|8@1+ (1,0) [0|255] "" XXX
 SG_ HEADER_BYTE_1 : 8|8@1+ (1,0) [0|255] "" XXX
 SG_ HEADER_BYTE_2 : 16|8@1+ (1,0) [0|255] "" XXX
 SG_ HEADER_BYTE_3 : 24|8@1+ (1,0) [0|255] "" XXX
 SG_ SLOT1_DISTANCE_RAW : 32|13@1+ (1,0) [0|8191] "" XXX
 SG_ SLOT1_META_13_15 : 45|3@1+ (1,0) [0|7] "" XXX
 SG_ SLOT1_META_BYTE_2 : 48|8@1+ (1,0) [0|255] "" XXX
 SG_ SLOT1_META_BYTE_3 : 56|8@1+ (1,0) [0|255] "" XXX
 SG_ SLOT2_DISTANCE_RAW : 64|13@1+ (1,0) [0|8191] "" XXX
 SG_ SLOT2_META_13_15 : 77|3@1+ (1,0) [0|7] "" XXX
 SG_ SLOT2_META_BYTE_2 : 80|8@1+ (1,0) [0|255] "" XXX
 SG_ SLOT2_META_BYTE_3 : 88|8@1+ (1,0) [0|255] "" XXX
 SG_ SLOT3_DISTANCE_RAW : 96|13@1+ (1,0) [0|8191] "" XXX
 SG_ SLOT3_META_13_15 : 109|3@1+ (1,0) [0|7] "" XXX
 SG_ SLOT3_META_BYTE_2 : 112|8@1+ (1,0) [0|255] "" XXX
 SG_ SLOT3_META_BYTE_3 : 120|8@1+ (1,0) [0|255] "" XXX
 SG_ SLOT4_DISTANCE_RAW : 128|13@1+ (1,0) [0|8191] "" XXX
 SG_ SLOT4_META_13_15 : 141|3@1+ (1,0) [0|7] "" XXX
 SG_ SLOT4_META_BYTE_2 : 144|8@1+ (1,0) [0|255] "" XXX
 SG_ SLOT4_META_BYTE_3 : 152|8@1+ (1,0) [0|255] "" XXX
 SG_ SLOT5_DISTANCE_RAW : 160|13@1+ (1,0) [0|8191] "" XXX
 SG_ SLOT5_META_13_15 : 173|3@1+ (1,0) [0|7] "" XXX
 SG_ SLOT5_META_BYTE_2 : 176|8@1+ (1,0) [0|255] "" XXX
 SG_ SLOT5_META_BYTE_3 : 184|8@1+ (1,0) [0|255] "" XXX
 SG_ SLOT6_DISTANCE_RAW : 192|13@1+ (1,0) [0|8191] "" XXX
 SG_ SLOT6_META_13_15 : 205|3@1+ (1,0) [0|7] "" XXX
 SG_ SLOT6_META_BYTE_2 : 208|8@1+ (1,0) [0|255] "" XXX
 SG_ SLOT6_META_BYTE_3 : 216|8@1+ (1,0) [0|255] "" XXX
 SG_ SLOT7_DISTANCE_RAW : 224|13@1+ (1,0) [0|8191] "" XXX
 SG_ SLOT7_META_13_15 : 237|3@1+ (1,0) [0|7] "" XXX
 SG_ SLOT7_META_BYTE_2 : 240|8@1+ (1,0) [0|255] "" XXX
 SG_ SLOT7_META_BYTE_3 : 248|8@1+ (1,0) [0|255] "" XXX
CM_ BO_ 1089 "IONIQ 9 candidate corner radar bin container. 0x430-0x437 correlate with left side and 0x440-0x447 with right side. Bytes 4-31 appear as seven 4-byte slots; lower 13 bits are a distance candidate at 0.05 m scale. This DBC intentionally exposes only raw candidate fields until lateral and velocity fields are validated.";
BA_ "GenMsgCycleTime" BO_ 1089 30;

BO_ 1090 CORNER_RADAR_430_OBJECTS_442: 32 RADAR
 SG_ HEADER_BYTE_0 : 0|8@1+ (1,0) [0|255] "" XXX
 SG_ HEADER_BYTE_1 : 8|8@1+ (1,0) [0|255] "" XXX
 SG_ HEADER_BYTE_2 : 16|8@1+ (1,0) [0|255] "" XXX
 SG_ HEADER_BYTE_3 : 24|8@1+ (1,0) [0|255] "" XXX
 SG_ SLOT1_DISTANCE_RAW : 32|13@1+ (1,0) [0|8191] "" XXX
 SG_ SLOT1_META_13_15 : 45|3@1+ (1,0) [0|7] "" XXX
 SG_ SLOT1_META_BYTE_2 : 48|8@1+ (1,0) [0|255] "" XXX
 SG_ SLOT1_META_BYTE_3 : 56|8@1+ (1,0) [0|255] "" XXX
 SG_ SLOT2_DISTANCE_RAW : 64|13@1+ (1,0) [0|8191] "" XXX
 SG_ SLOT2_META_13_15 : 77|3@1+ (1,0) [0|7] "" XXX
 SG_ SLOT2_META_BYTE_2 : 80|8@1+ (1,0) [0|255] "" XXX
 SG_ SLOT2_META_BYTE_3 : 88|8@1+ (1,0) [0|255] "" XXX
 SG_ SLOT3_DISTANCE_RAW : 96|13@1+ (1,0) [0|8191] "" XXX
 SG_ SLOT3_META_13_15 : 109|3@1+ (1,0) [0|7] "" XXX
 SG_ SLOT3_META_BYTE_2 : 112|8@1+ (1,0) [0|255] "" XXX
 SG_ SLOT3_META_BYTE_3 : 120|8@1+ (1,0) [0|255] "" XXX
 SG_ SLOT4_DISTANCE_RAW : 128|13@1+ (1,0) [0|8191] "" XXX
 SG_ SLOT4_META_13_15 : 141|3@1+ (1,0) [0|7] "" XXX
 SG_ SLOT4_META_BYTE_2 : 144|8@1+ (1,0) [0|255] "" XXX
 SG_ SLOT4_META_BYTE_3 : 152|8@1+ (1,0) [0|255] "" XXX
 SG_ SLOT5_DISTANCE_RAW : 160|13@1+ (1,0) [0|8191] "" XXX
 SG_ SLOT5_META_13_15 : 173|3@1+ (1,0) [0|7] "" XXX
 SG_ SLOT5_META_BYTE_2 : 176|8@1+ (1,0) [0|255] "" XXX
 SG_ SLOT5_META_BYTE_3 : 184|8@1+ (1,0) [0|255] "" XXX
 SG_ SLOT6_DISTANCE_RAW : 192|13@1+ (1,0) [0|8191] "" XXX
 SG_ SLOT6_META_13_15 : 205|3@1+ (1,0) [0|7] "" XXX
 SG_ SLOT6_META_BYTE_2 : 208|8@1+ (1,0) [0|255] "" XXX
 SG_ SLOT6_META_BYTE_3 : 216|8@1+ (1,0) [0|255] "" XXX
 SG_ SLOT7_DISTANCE_RAW : 224|13@1+ (1,0) [0|8191] "" XXX
 SG_ SLOT7_META_13_15 : 237|3@1+ (1,0) [0|7] "" XXX
 SG_ SLOT7_META_BYTE_2 : 240|8@1+ (1,0) [0|255] "" XXX
 SG_ SLOT7_META_BYTE_3 : 248|8@1+ (1,0) [0|255] "" XXX
CM_ BO_ 1090 "IONIQ 9 candidate corner radar bin container. 0x430-0x437 correlate with left side and 0x440-0x447 with right side. Bytes 4-31 appear as seven 4-byte slots; lower 13 bits are a distance candidate at 0.05 m scale. This DBC intentionally exposes only raw candidate fields until lateral and velocity fields are validated.";
BA_ "GenMsgCycleTime" BO_ 1090 30;

BO_ 1091 CORNER_RADAR_430_OBJECTS_443: 32 RADAR
 SG_ HEADER_BYTE_0 : 0|8@1+ (1,0) [0|255] "" XXX
 SG_ HEADER_BYTE_1 : 8|8@1+ (1,0) [0|255] "" XXX
 SG_ HEADER_BYTE_2 : 16|8@1+ (1,0) [0|255] "" XXX
 SG_ HEADER_BYTE_3 : 24|8@1+ (1,0) [0|255] "" XXX
 SG_ SLOT1_DISTANCE_RAW : 32|13@1+ (1,0) [0|8191] "" XXX
 SG_ SLOT1_META_13_15 : 45|3@1+ (1,0) [0|7] "" XXX
 SG_ SLOT1_META_BYTE_2 : 48|8@1+ (1,0) [0|255] "" XXX
 SG_ SLOT1_META_BYTE_3 : 56|8@1+ (1,0) [0|255] "" XXX
 SG_ SLOT2_DISTANCE_RAW : 64|13@1+ (1,0) [0|8191] "" XXX
 SG_ SLOT2_META_13_15 : 77|3@1+ (1,0) [0|7] "" XXX
 SG_ SLOT2_META_BYTE_2 : 80|8@1+ (1,0) [0|255] "" XXX
 SG_ SLOT2_META_BYTE_3 : 88|8@1+ (1,0) [0|255] "" XXX
 SG_ SLOT3_DISTANCE_RAW : 96|13@1+ (1,0) [0|8191] "" XXX
 SG_ SLOT3_META_13_15 : 109|3@1+ (1,0) [0|7] "" XXX
 SG_ SLOT3_META_BYTE_2 : 112|8@1+ (1,0) [0|255] "" XXX
 SG_ SLOT3_META_BYTE_3 : 120|8@1+ (1,0) [0|255] "" XXX
 SG_ SLOT4_DISTANCE_RAW : 128|13@1+ (1,0) [0|8191] "" XXX
 SG_ SLOT4_META_13_15 : 141|3@1+ (1,0) [0|7] "" XXX
 SG_ SLOT4_META_BYTE_2 : 144|8@1+ (1,0) [0|255] "" XXX
 SG_ SLOT4_META_BYTE_3 : 152|8@1+ (1,0) [0|255] "" XXX
 SG_ SLOT5_DISTANCE_RAW : 160|13@1+ (1,0) [0|8191] "" XXX
 SG_ SLOT5_META_13_15 : 173|3@1+ (1,0) [0|7] "" XXX
 SG_ SLOT5_META_BYTE_2 : 176|8@1+ (1,0) [0|255] "" XXX
 SG_ SLOT5_META_BYTE_3 : 184|8@1+ (1,0) [0|255] "" XXX
 SG_ SLOT6_DISTANCE_RAW : 192|13@1+ (1,0) [0|8191] "" XXX
 SG_ SLOT6_META_13_15 : 205|3@1+ (1,0) [0|7] "" XXX
 SG_ SLOT6_META_BYTE_2 : 208|8@1+ (1,0) [0|255] "" XXX
 SG_ SLOT6_META_BYTE_3 : 216|8@1+ (1,0) [0|255] "" XXX
 SG_ SLOT7_DISTANCE_RAW : 224|13@1+ (1,0) [0|8191] "" XXX
 SG_ SLOT7_META_13_15 : 237|3@1+ (1,0) [0|7] "" XXX
 SG_ SLOT7_META_BYTE_2 : 240|8@1+ (1,0) [0|255] "" XXX
 SG_ SLOT7_META_BYTE_3 : 248|8@1+ (1,0) [0|255] "" XXX
CM_ BO_ 1091 "IONIQ 9 candidate corner radar bin container. 0x430-0x437 correlate with left side and 0x440-0x447 with right side. Bytes 4-31 appear as seven 4-byte slots; lower 13 bits are a distance candidate at 0.05 m scale. This DBC intentionally exposes only raw candidate fields until lateral and velocity fields are validated.";
BA_ "GenMsgCycleTime" BO_ 1091 30;

BO_ 1092 CORNER_RADAR_430_OBJECTS_444: 32 RADAR
 SG_ HEADER_BYTE_0 : 0|8@1+ (1,0) [0|255] "" XXX
 SG_ HEADER_BYTE_1 : 8|8@1+ (1,0) [0|255] "" XXX
 SG_ HEADER_BYTE_2 : 16|8@1+ (1,0) [0|255] "" XXX
 SG_ HEADER_BYTE_3 : 24|8@1+ (1,0) [0|255] "" XXX
 SG_ SLOT1_DISTANCE_RAW : 32|13@1+ (1,0) [0|8191] "" XXX
 SG_ SLOT1_META_13_15 : 45|3@1+ (1,0) [0|7] "" XXX
 SG_ SLOT1_META_BYTE_2 : 48|8@1+ (1,0) [0|255] "" XXX
 SG_ SLOT1_META_BYTE_3 : 56|8@1+ (1,0) [0|255] "" XXX
 SG_ SLOT2_DISTANCE_RAW : 64|13@1+ (1,0) [0|8191] "" XXX
 SG_ SLOT2_META_13_15 : 77|3@1+ (1,0) [0|7] "" XXX
 SG_ SLOT2_META_BYTE_2 : 80|8@1+ (1,0) [0|255] "" XXX
 SG_ SLOT2_META_BYTE_3 : 88|8@1+ (1,0) [0|255] "" XXX
 SG_ SLOT3_DISTANCE_RAW : 96|13@1+ (1,0) [0|8191] "" XXX
 SG_ SLOT3_META_13_15 : 109|3@1+ (1,0) [0|7] "" XXX
 SG_ SLOT3_META_BYTE_2 : 112|8@1+ (1,0) [0|255] "" XXX
 SG_ SLOT3_META_BYTE_3 : 120|8@1+ (1,0) [0|255] "" XXX
 SG_ SLOT4_DISTANCE_RAW : 128|13@1+ (1,0) [0|8191] "" XXX
 SG_ SLOT4_META_13_15 : 141|3@1+ (1,0) [0|7] "" XXX
 SG_ SLOT4_META_BYTE_2 : 144|8@1+ (1,0) [0|255] "" XXX
 SG_ SLOT4_META_BYTE_3 : 152|8@1+ (1,0) [0|255] "" XXX
 SG_ SLOT5_DISTANCE_RAW : 160|13@1+ (1,0) [0|8191] "" XXX
 SG_ SLOT5_META_13_15 : 173|3@1+ (1,0) [0|7] "" XXX
 SG_ SLOT5_META_BYTE_2 : 176|8@1+ (1,0) [0|255] "" XXX
 SG_ SLOT5_META_BYTE_3 : 184|8@1+ (1,0) [0|255] "" XXX
 SG_ SLOT6_DISTANCE_RAW : 192|13@1+ (1,0) [0|8191] "" XXX
 SG_ SLOT6_META_13_15 : 205|3@1+ (1,0) [0|7] "" XXX
 SG_ SLOT6_META_BYTE_2 : 208|8@1+ (1,0) [0|255] "" XXX
 SG_ SLOT6_META_BYTE_3 : 216|8@1+ (1,0) [0|255] "" XXX
 SG_ SLOT7_DISTANCE_RAW : 224|13@1+ (1,0) [0|8191] "" XXX
 SG_ SLOT7_META_13_15 : 237|3@1+ (1,0) [0|7] "" XXX
 SG_ SLOT7_META_BYTE_2 : 240|8@1+ (1,0) [0|255] "" XXX
 SG_ SLOT7_META_BYTE_3 : 248|8@1+ (1,0) [0|255] "" XXX
CM_ BO_ 1092 "IONIQ 9 candidate corner radar bin container. 0x430-0x437 correlate with left side and 0x440-0x447 with right side. Bytes 4-31 appear as seven 4-byte slots; lower 13 bits are a distance candidate at 0.05 m scale. This DBC intentionally exposes only raw candidate fields until lateral and velocity fields are validated.";
BA_ "GenMsgCycleTime" BO_ 1092 30;

BO_ 1093 CORNER_RADAR_430_OBJECTS_445: 32 RADAR
 SG_ HEADER_BYTE_0 : 0|8@1+ (1,0) [0|255] "" XXX
 SG_ HEADER_BYTE_1 : 8|8@1+ (1,0) [0|255] "" XXX
 SG_ HEADER_BYTE_2 : 16|8@1+ (1,0) [0|255] "" XXX
 SG_ HEADER_BYTE_3 : 24|8@1+ (1,0) [0|255] "" XXX
 SG_ SLOT1_DISTANCE_RAW : 32|13@1+ (1,0) [0|8191] "" XXX
 SG_ SLOT1_META_13_15 : 45|3@1+ (1,0) [0|7] "" XXX
 SG_ SLOT1_META_BYTE_2 : 48|8@1+ (1,0) [0|255] "" XXX
 SG_ SLOT1_META_BYTE_3 : 56|8@1+ (1,0) [0|255] "" XXX
 SG_ SLOT2_DISTANCE_RAW : 64|13@1+ (1,0) [0|8191] "" XXX
 SG_ SLOT2_META_13_15 : 77|3@1+ (1,0) [0|7] "" XXX
 SG_ SLOT2_META_BYTE_2 : 80|8@1+ (1,0) [0|255] "" XXX
 SG_ SLOT2_META_BYTE_3 : 88|8@1+ (1,0) [0|255] "" XXX
 SG_ SLOT3_DISTANCE_RAW : 96|13@1+ (1,0) [0|8191] "" XXX
 SG_ SLOT3_META_13_15 : 109|3@1+ (1,0) [0|7] "" XXX
 SG_ SLOT3_META_BYTE_2 : 112|8@1+ (1,0) [0|255] "" XXX
 SG_ SLOT3_META_BYTE_3 : 120|8@1+ (1,0) [0|255] "" XXX
 SG_ SLOT4_DISTANCE_RAW : 128|13@1+ (1,0) [0|8191] "" XXX
 SG_ SLOT4_META_13_15 : 141|3@1+ (1,0) [0|7] "" XXX
 SG_ SLOT4_META_BYTE_2 : 144|8@1+ (1,0) [0|255] "" XXX
 SG_ SLOT4_META_BYTE_3 : 152|8@1+ (1,0) [0|255] "" XXX
 SG_ SLOT5_DISTANCE_RAW : 160|13@1+ (1,0) [0|8191] "" XXX
 SG_ SLOT5_META_13_15 : 173|3@1+ (1,0) [0|7] "" XXX
 SG_ SLOT5_META_BYTE_2 : 176|8@1+ (1,0) [0|255] "" XXX
 SG_ SLOT5_META_BYTE_3 : 184|8@1+ (1,0) [0|255] "" XXX
 SG_ SLOT6_DISTANCE_RAW : 192|13@1+ (1,0) [0|8191] "" XXX
 SG_ SLOT6_META_13_15 : 205|3@1+ (1,0) [0|7] "" XXX
 SG_ SLOT6_META_BYTE_2 : 208|8@1+ (1,0) [0|255] "" XXX
 SG_ SLOT6_META_BYTE_3 : 216|8@1+ (1,0) [0|255] "" XXX
 SG_ SLOT7_DISTANCE_RAW : 224|13@1+ (1,0) [0|8191] "" XXX
 SG_ SLOT7_META_13_15 : 237|3@1+ (1,0) [0|7] "" XXX
 SG_ SLOT7_META_BYTE_2 : 240|8@1+ (1,0) [0|255] "" XXX
 SG_ SLOT7_META_BYTE_3 : 248|8@1+ (1,0) [0|255] "" XXX
CM_ BO_ 1093 "IONIQ 9 candidate corner radar bin container. 0x430-0x437 correlate with left side and 0x440-0x447 with right side. Bytes 4-31 appear as seven 4-byte slots; lower 13 bits are a distance candidate at 0.05 m scale. This DBC intentionally exposes only raw candidate fields until lateral and velocity fields are validated.";
BA_ "GenMsgCycleTime" BO_ 1093 30;

BO_ 1094 CORNER_RADAR_430_OBJECTS_446: 32 RADAR
 SG_ HEADER_BYTE_0 : 0|8@1+ (1,0) [0|255] "" XXX
 SG_ HEADER_BYTE_1 : 8|8@1+ (1,0) [0|255] "" XXX
 SG_ HEADER_BYTE_2 : 16|8@1+ (1,0) [0|255] "" XXX
 SG_ HEADER_BYTE_3 : 24|8@1+ (1,0) [0|255] "" XXX
 SG_ SLOT1_DISTANCE_RAW : 32|13@1+ (1,0) [0|8191] "" XXX
 SG_ SLOT1_META_13_15 : 45|3@1+ (1,0) [0|7] "" XXX
 SG_ SLOT1_META_BYTE_2 : 48|8@1+ (1,0) [0|255] "" XXX
 SG_ SLOT1_META_BYTE_3 : 56|8@1+ (1,0) [0|255] "" XXX
 SG_ SLOT2_DISTANCE_RAW : 64|13@1+ (1,0) [0|8191] "" XXX
 SG_ SLOT2_META_13_15 : 77|3@1+ (1,0) [0|7] "" XXX
 SG_ SLOT2_META_BYTE_2 : 80|8@1+ (1,0) [0|255] "" XXX
 SG_ SLOT2_META_BYTE_3 : 88|8@1+ (1,0) [0|255] "" XXX
 SG_ SLOT3_DISTANCE_RAW : 96|13@1+ (1,0) [0|8191] "" XXX
 SG_ SLOT3_META_13_15 : 109|3@1+ (1,0) [0|7] "" XXX
 SG_ SLOT3_META_BYTE_2 : 112|8@1+ (1,0) [0|255] "" XXX
 SG_ SLOT3_META_BYTE_3 : 120|8@1+ (1,0) [0|255] "" XXX
 SG_ SLOT4_DISTANCE_RAW : 128|13@1+ (1,0) [0|8191] "" XXX
 SG_ SLOT4_META_13_15 : 141|3@1+ (1,0) [0|7] "" XXX
 SG_ SLOT4_META_BYTE_2 : 144|8@1+ (1,0) [0|255] "" XXX
 SG_ SLOT4_META_BYTE_3 : 152|8@1+ (1,0) [0|255] "" XXX
 SG_ SLOT5_DISTANCE_RAW : 160|13@1+ (1,0) [0|8191] "" XXX
 SG_ SLOT5_META_13_15 : 173|3@1+ (1,0) [0|7] "" XXX
 SG_ SLOT5_META_BYTE_2 : 176|8@1+ (1,0) [0|255] "" XXX
 SG_ SLOT5_META_BYTE_3 : 184|8@1+ (1,0) [0|255] "" XXX
 SG_ SLOT6_DISTANCE_RAW : 192|13@1+ (1,0) [0|8191] "" XXX
 SG_ SLOT6_META_13_15 : 205|3@1+ (1,0) [0|7] "" XXX
 SG_ SLOT6_META_BYTE_2 : 208|8@1+ (1,0) [0|255] "" XXX
 SG_ SLOT6_META_BYTE_3 : 216|8@1+ (1,0) [0|255] "" XXX
 SG_ SLOT7_DISTANCE_RAW : 224|13@1+ (1,0) [0|8191] "" XXX
 SG_ SLOT7_META_13_15 : 237|3@1+ (1,0) [0|7] "" XXX
 SG_ SLOT7_META_BYTE_2 : 240|8@1+ (1,0) [0|255] "" XXX
 SG_ SLOT7_META_BYTE_3 : 248|8@1+ (1,0) [0|255] "" XXX
CM_ BO_ 1094 "IONIQ 9 candidate corner radar bin container. 0x430-0x437 correlate with left side and 0x440-0x447 with right side. Bytes 4-31 appear as seven 4-byte slots; lower 13 bits are a distance candidate at 0.05 m scale. This DBC intentionally exposes only raw candidate fields until lateral and velocity fields are validated.";
BA_ "GenMsgCycleTime" BO_ 1094 30;

BO_ 1095 CORNER_RADAR_430_OBJECTS_447: 32 RADAR
 SG_ HEADER_BYTE_0 : 0|8@1+ (1,0) [0|255] "" XXX
 SG_ HEADER_BYTE_1 : 8|8@1+ (1,0) [0|255] "" XXX
 SG_ HEADER_BYTE_2 : 16|8@1+ (1,0) [0|255] "" XXX
 SG_ HEADER_BYTE_3 : 24|8@1+ (1,0) [0|255] "" XXX
 SG_ SLOT1_DISTANCE_RAW : 32|13@1+ (1,0) [0|8191] "" XXX
 SG_ SLOT1_META_13_15 : 45|3@1+ (1,0) [0|7] "" XXX
 SG_ SLOT1_META_BYTE_2 : 48|8@1+ (1,0) [0|255] "" XXX
 SG_ SLOT1_META_BYTE_3 : 56|8@1+ (1,0) [0|255] "" XXX
 SG_ SLOT2_DISTANCE_RAW : 64|13@1+ (1,0) [0|8191] "" XXX
 SG_ SLOT2_META_13_15 : 77|3@1+ (1,0) [0|7] "" XXX
 SG_ SLOT2_META_BYTE_2 : 80|8@1+ (1,0) [0|255] "" XXX
 SG_ SLOT2_META_BYTE_3 : 88|8@1+ (1,0) [0|255] "" XXX
 SG_ SLOT3_DISTANCE_RAW : 96|13@1+ (1,0) [0|8191] "" XXX
 SG_ SLOT3_META_13_15 : 109|3@1+ (1,0) [0|7] "" XXX
 SG_ SLOT3_META_BYTE_2 : 112|8@1+ (1,0) [0|255] "" XXX
 SG_ SLOT3_META_BYTE_3 : 120|8@1+ (1,0) [0|255] "" XXX
 SG_ SLOT4_DISTANCE_RAW : 128|13@1+ (1,0) [0|8191] "" XXX
 SG_ SLOT4_META_13_15 : 141|3@1+ (1,0) [0|7] "" XXX
 SG_ SLOT4_META_BYTE_2 : 144|8@1+ (1,0) [0|255] "" XXX
 SG_ SLOT4_META_BYTE_3 : 152|8@1+ (1,0) [0|255] "" XXX
 SG_ SLOT5_DISTANCE_RAW : 160|13@1+ (1,0) [0|8191] "" XXX
 SG_ SLOT5_META_13_15 : 173|3@1+ (1,0) [0|7] "" XXX
 SG_ SLOT5_META_BYTE_2 : 176|8@1+ (1,0) [0|255] "" XXX
 SG_ SLOT5_META_BYTE_3 : 184|8@1+ (1,0) [0|255] "" XXX
 SG_ SLOT6_DISTANCE_RAW : 192|13@1+ (1,0) [0|8191] "" XXX
 SG_ SLOT6_META_13_15 : 205|3@1+ (1,0) [0|7] "" XXX
 SG_ SLOT6_META_BYTE_2 : 208|8@1+ (1,0) [0|255] "" XXX
 SG_ SLOT6_META_BYTE_3 : 216|8@1+ (1,0) [0|255] "" XXX
 SG_ SLOT7_DISTANCE_RAW : 224|13@1+ (1,0) [0|8191] "" XXX
 SG_ SLOT7_META_13_15 : 237|3@1+ (1,0) [0|7] "" XXX
 SG_ SLOT7_META_BYTE_2 : 240|8@1+ (1,0) [0|255] "" XXX
 SG_ SLOT7_META_BYTE_3 : 248|8@1+ (1,0) [0|255] "" XXX
CM_ BO_ 1095 "IONIQ 9 candidate corner radar bin container. 0x430-0x437 correlate with left side and 0x440-0x447 with right side. Bytes 4-31 appear as seven 4-byte slots; lower 13 bits are a distance candidate at 0.05 m scale. This DBC intentionally exposes only raw candidate fields until lateral and velocity fields are validated.";
BA_ "GenMsgCycleTime" BO_ 1095 30;
